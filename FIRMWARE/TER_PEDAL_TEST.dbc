VERSION ""

NS_ :

BS_:
BU_: TER_PEDAL
BO_ 2147484020 APPS: 8 TER_PEDAL
   SG_ ACCEL_1 : 7|8@0+ (1,0) [0|1] "" TER_PEDAL

BA_DEF_ BO_ "GenMsgBackgroundColor" STRING ;
BA_DEF_ BO_ "GenMsgForegroundColor" STRING ;
BA_DEF_ BO_ "filterlabeling" INT 0 0;
BA_DEF_DEF_ "GenMsgBackgroundColor" "#ffffff";
BA_DEF_DEF_ "GenMsgForegroundColor" "#000000";
BA_DEF_DEF_ "filterlabeling" 1;
CM_ BU_ TER_PEDAL "Pedal Sensors";
